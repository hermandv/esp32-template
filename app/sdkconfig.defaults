## bootloader_components/devlink_boot/Kconfig
```kconfig
menu "devlink bootloader"

    config DEVLINK_BOOT_RECOVERY_GPIO
        int "Recovery GPIO (held low at reset -> recovery), -1 = none"
        default -1
        range -1 48
        help
            SPEC §3.4 rule 4, optional. Must be a non-strapping pin (never GPIO0, 3, 45, 46) and not GPIO19/20
            (USB). Frozen with the bootloader.

endmenu
```

## components/devlink/Kconfig
```kconfig
menu "devlink"

    config DEVLINK_AP_PASSWORD
        string "Config AP password (WPA2, >= 8 characters; same in app and recovery)"
        default "configure"

    config DEVLINK_API_KEY
        string "API key for mutating requests (X-Api-Key; fixed at build time)"
        default "devlink-bench"

    config DEVLINK_PROJECT_PREFIX
        string "Required project-name prefix for OTA images (empty = no check; force=1 overrides)"
        default ""

    config DEVLINK_BOARD
        string "Board / variant name reported in /info"
        default "s3-devkit"

    config DEVLINK_TX_POWER_DBM
        int "Recovery Wi-Fi TX power (dBm; reduced to survive weak supplies, SPEC 6.4)"
        default 11
        range 2 20

    config DEVLINK_TX_POWER_BROWNOUT_DBM
        int "Recovery Wi-Fi TX power after a brownout reset (dBm)"
        default 8
        range 2 20

    config DEVLINK_BUTTON_GPIO
        int "Button GPIO (app: hold 3 s -> config AP, 10 s -> recovery; -1 = none)"
        default 0
        range -1 48
        help
            SPEC 5.9. Default GPIO0 (BOOT). Runtime only: GPIO0 low at reset enters ROM download mode.

    config DEVLINK_SELFTEST_S
        int "App self-test time limit (s) before a new app is rolled back"
        default 60
        range 10 85
        help
            Must be shorter than the 90 s RTC WDT verify window (SPEC 3.5).

    config DEVLINK_BLOCK_SLOTS
        int "Block channels: ring slots per WebSocket client (0 = block channels off)"
        default 16
        range 0 64
        help
            SPEC 5.7. Each slot holds one binary block (1.4 KB). A client's ring is allocated from the heap when it
            first subscribes to a block channel and freed when it disconnects, so an app without block channels
            pays nothing. 16 slots = about 0.8 s of 50 ms blocks. Recovery sets 0.

    config DEVLINK_TEST_NO_HTTP
        bool "TEST BUILDS: never start the HTTP API (acceptance test 7)"
        default n

    config DEVLINK_TEST_CONSOLE
        bool "TEST BUILDS: extra console commands for the HIL tests (fault injection)"
        default n
        help
            Adds the test console (test/fw/components/devlink_testcon) commands to the USB console.
            Never enable in a release build.

endmenu
```

## recovery/main/Kconfig.projbuild
```kconfig
menu "devlink recovery (test options)"

    config DEVLINK_TEST_RECOVERY_CRASH
        bool "TEST BUILD: crash at start (acceptance test 20)"
        default n

endmenu
```

## test/fw/bootlab/main/Kconfig.projbuild
```kconfig
menu "bootlab (test app) fault variants"

    config BOOTLAB_FAULT_PANIC
        bool "Panic right at start (acceptance test 5)"
        default n

    config BOOTLAB_FAULT_HANG
        bool "Hang before the self-test, all of app_main blocked (acceptance test 6)"
        default n

endmenu
```

## test/fw/bootlab/sdkconfig.defaults
```kconfig
CONFIG_APP_PROJECT_VER_FROM_CONFIG=y
CONFIG_APP_PROJECT_VER="bootlab-1"
CONFIG_ESP_CONSOLE_USB_SERIAL_JTAG=y
CONFIG_PARTITION_TABLE_CUSTOM_FILENAME="../../../tools/partitions_8mb.csv"
```
